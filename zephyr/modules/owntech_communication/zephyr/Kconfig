## zephyr/modules/owntech_communication/zephyr/Kconfig
```kconfig
# The chosen node name holds a comma, so it is passed through a variable.
DT_CHOSEN_THINGSET_CAN := thingset,can

config OWNTECH_DT_THINGSET_CAN_ENABLED
	def_bool $(dt_chosen_enabled,$(DT_CHOSEN_THINGSET_CAN))
	help
	  The device tree has a `thingset,can` chosen node whose CAN controller
	  is enabled, which ThingSet over CAN (OWNTECH_COMMUNICATION_ENABLE_CAN)
	  needs. The module's CMakeLists.txt stops the build with a clear
	  message when the CAN API is enabled without it.

config OWNTECH_COMMUNICATION
	bool "Enable OwnTech communication module [EXPERIMENTAL]"
	# OwnTech Communication API in still experimental: disable by default
	default n
	depends on OWNTECH_SHIELD_API
	help
		This experimental module provides various ways of communicating
		(CAN, RS485, analog) for OwnTech Power API.
		It is an experimental module still not ready for production.

if OWNTECH_COMMUNICATION

	config OWNTECH_COMMUNICATION_ENABLE_ANALOG
		bool "Enable Analog communication API"
		default y

	config OWNTECH_COMMUNICATION_ENABLE_CAN
		bool "Enable CAN bus communication API (Thingset over CAN)"
		default n
		select ENTROPY_GENERATOR
		select CAN
		select ISOTP
		select ISOTP_FAST
		select THINGSET
		select THINGSET_SDK
		select THINGSET_CAN
		select THINGSET_CAN_ITEM_RX
		help
		  ThingSet over CAN runs on the CAN controller of the
		  `thingset,can` chosen node, which the shield device tree must
		  enable (Twist 1.4.x and Ownverter do; Twist 1.3.0 does not):
		  otherwise the build stops with an error naming this option.

	config OWNTECH_COMMUNICATION_ENABLE_RS485
		bool "Enable RS485 bus communication API"
		default y

	config OWNTECH_COMMUNICATION_ENABLE_SYNC
		bool "Enable synchronization API"
		default y

endif
```
